## boards/nxp/frdm_k22f/Kconfig.frdm_k22f
```kconfig
# Copyright 2024 NXP
# SPDX-License-Identifier: Apache-2.0

config BOARD_FRDM_K22F
	select SOC_MK22F51212

config SOC_PART_NUMBER
	default "MK22FN512VLH12"
```

## boards/nxp/frdm_k64f/Kconfig.frdm_k64f
```kconfig
# Copyright 2024 NXP
# SPDX-License-Identifier: Apache-2.0

config BOARD_FRDM_K64F
	select SOC_MK64F12

config SOC_PART_NUMBER
	default "MK64FN1M0VLL12"
```

## boards/nxp/frdm_k82f/Kconfig.frdm_k82f
```kconfig
# Copyright 2024 NXP
# SPDX-License-Identifier: Apache-2.0

config BOARD_FRDM_K82F
	select SOC_MK82F25615

config SOC_PART_NUMBER
	default "MK82FN256VLL15"
```

## boards/nxp/frdm_kl25z/Kconfig.frdm_kl25z
```kconfig
# Copyright 2024 NXP
# SPDX-License-Identifier: Apache-2.0

config BOARD_FRDM_KL25Z
	select SOC_MKL25Z4

config SOC_PART_NUMBER
	default "MKL25Z128VLK4"
```

## boards/nxp/frdm_kw41z/Kconfig.frdm_kw41z
```kconfig
# Copyright 2024 NXP
# SPDX-License-Identifier: Apache-2.0

config BOARD_FRDM_KW41Z
	select SOC_MKW41Z4

config SOC_PART_NUMBER
	default "MKW41Z512VHT4"
```

## boards/nxp/hexiwear/Kconfig.hexiwear
```kconfig
# Copyright 2024 NXP
# SPDX-License-Identifier: Apache-2.0

config BOARD_HEXIWEAR_MK64F12
	bool
	select SOC_MK64F12

config BOARD_HEXIWEAR_MKW40Z4
	bool
	select SOC_MKW40Z4

config SOC_PART_NUMBER
	default "MK64FN1M0VDC12" if BOARD_HEXIWEAR_MK64F12
	default "MKW40Z160VHT4" if BOARD_HEXIWEAR_MKW40Z4
```

## boards/nxp/rddrone_fmuk66/Kconfig.rddrone_fmuk66
```kconfig
# Copyright 2024 NXP
# SPDX-License-Identifier: Apache-2.0

config BOARD_RDDRONE_FMUK66
	select SOC_MK66F18

config SOC_PART_NUMBER
	default "MK66FN2M0VLQ18"
```

## boards/nxp/twr_ke18f/Kconfig.twr_ke18f
```kconfig
# Copyright 2024 NXP
# SPDX-License-Identifier: Apache-2.0

config BOARD_TWR_KE18F
	select SOC_MKE18F16

config SOC_PART_NUMBER
	default "MKE18F512VLL16"
```

## boards/nxp/usb_kw24d512/Kconfig.usb_kw24d512
```kconfig
# Copyright 2024 NXP
# SPDX-License-Identifier: Apache-2.0

config BOARD_USB_KW24D512
	select SOC_MKW24D5

config SOC_PART_NUMBER
	default "MKW24D512VHA5"
```

## boards/segger/ip_k66f/Kconfig.ip_k66f
```kconfig
# Copyright 2024 NXP
# SPDX-License-Identifier: Apache-2.0

config BOARD_IP_K66F
	select SOC_MK66F18

config SOC_PART_NUMBER
	default "MK66FN2M0VMD18"
```

## drivers/pwm/Kconfig.mcux_flexio
```kconfig
# Copyright (c) 2024, NXP
# SPDX-License-Identifier: Apache-2.0

config PWM_MCUX_FLEXIO
	bool "MCUX Flexio PWM driver"
	default y
	depends on DT_HAS_NXP_FLEXIO_ENABLED
	depends on CLOCK_CONTROL
	select MCUX_FLEXIO
	help
	  Enable flexio based pwm driver.
```

## drivers/sdhc/Kconfig
```kconfig
# Copyright 2022 NXP
# SPDX-License-Identifier: Apache-2.0

source "drivers/sdhc/Kconfig.imx"

menuconfig SDHC
	bool "SDHC drivers"
	help
	  Include drivers for SD host controller

if SDHC

config SDHC_INIT_PRIORITY
	int "SDHC driver init priority"
	default 85
	help
	  SDHC driver system init priority

config SDHC_BUFFER_ALIGNMENT
	int
	default 1
	help
	  Some SD host controllers require alignment of their data buffers
	  in order to DMA to work correctly. Devices should change default of
	  this value if they require alignment. This represents the alignment
	  of buffers required in bytes

module = SDHC
module-str = sdhc
source "subsys/logging/Kconfig.template.log_config"


endif # SDHC
```

## drivers/sdhc/Kconfig.imx
```kconfig
# Copyright (c) 2022, NXP
# SPDX -License-Identifier: Apache-2.0

config IMX_USDHC
	bool "NXP IMX USDHC Driver"
	depends on (HAS_MCUX_USDHC1 || HAS_MCUX_USDHC2)
	select NOCACHE_MEMORY
	help
	  Enable the NXP IMX SD Host controller driver

if IMX_USDHC

config IMX_USDHC_DAT3_PWR_TOGGLE
	bool "Toggle power when pulling DAT3 line low"
	default y
	help
	  Toggle power to SD card to clear DAT3 pull when pulling line low

config IMX_USDHC_DMA_BUFFER_SIZE
	int "Size of DMA descriptor buffer in bytes"
	default 128
	help
	  Size of USDHC ADMA descriptor buffer in bytes

# USDHC DMA needs 32 bit aligned buffers
config SDHC_BUFFER_ALIGNMENT
	default 4

endif
```

## dts/bindings/display/nxp,vglite.yaml
```yaml
# Copyright 2023 NXP
# SPDX-License-Identifier: Apache-2.0

description: |
  VGLite device node. This will enable the VGLite driver API, and attach it
  to a hardware device defined in devicetree. The VGLite API is currently
  integrated with LVGL, for graphical acceleration support.

compatible: "nxp,vglite"

include: base.yaml
```

## dts/bindings/pwm/nxp,flexio-pwm.yaml
```yaml
# (c) Meta Platforms, Inc. and affiliates.
# SPDX-License-Identifier: Apache-2.0

description: NXP Flexio PWM controller

compatible: "nxp,flexio-pwm"

include: [pwm-controller.yaml, pinctrl-device.yaml, base.yaml]

properties:
  pinctrl-0:
    required: true

  pinctrl-names:
    required: true

  timer-id:
    type: int
    required: true

  pin-id:
    type: int
    required: true

  polarity:
    type: int

  duty-cycle:
    type: int

  period:
    type: int

  prescaler:
    type: int
    enum: [0, 4, 5]

  "#pwm-cells":
    const: 3

pwm-cells:
  - channel
  # Period in terms of nanoseconds
  - period
  - flags
```

## soc/nxp/kinetis/k6x/Kconfig.soc
```kconfig
# Kinetis K6X MCU line

# Copyright 2024 NXP
# SPDX-License-Identifier: Apache-2.0

config SOC_SERIES_KINETIS_K6X
	bool
	select SOC_FAMILY_KINETIS

config SOC_SERIES
	default "k6x" if SOC_SERIES_KINETIS_K6X

config SOC_MK64F12
	bool
	select SOC_SERIES_KINETIS_K6X

config SOC_MK66F18
	bool
	select SOC_SERIES_KINETIS_K6X

config SOC
	default "mk64f12" if SOC_MK64F12
	default "mk66f18" if SOC_MK66F18
```

## soc/nxp/kinetis/k8x/Kconfig.soc
```kconfig
# Kinetis K8x series MCU

# Copyright 2024 NXP
# SPDX-License-Identifier: Apache-2.0

config SOC_SERIES_KINETIS_K8X
	bool
	select SOC_FAMILY_KINETIS

config SOC_SERIES
	default "k8x" if SOC_SERIES_KINETIS_K8X

config SOC_MK80F25615
	bool
	select SOC_SERIES_KINETIS_K8X

config SOC_MK82F25615
	bool
	select SOC_SERIES_KINETIS_K8X

config SOC
	default "mk80f25615" if SOC_MK80F25615
	default "mk82f25615" if SOC_MK82F25615
```

## soc/nxp/kinetis/ke1xf/Kconfig.soc
```kconfig
# Kinetis KE1xF MCU line

# Copyright 2024 NXP
# SPDX-License-Identifier: Apache-2.0

config SOC_SERIES_KINETIS_KE1XF
	bool
	select SOC_FAMILY_KINETIS

config SOC_SERIES
	default "ke1xf" if SOC_SERIES_KINETIS_KE1XF

config SOC_MKE14F16
	bool
	select SOC_SERIES_KINETIS_KE1XF

config SOC_MKE16F16
	bool
	select SOC_SERIES_KINETIS_KE1XF
	select HAS_MCUX_FLEXCAN

config SOC_MKE18F16
	bool
	select SOC_SERIES_KINETIS_KE1XF
	select HAS_MCUX_FLEXCAN

config SOC
	default "mke14f16" if SOC_MKE14F16
	default "mke16f16" if SOC_MKE16F16
	default "mke18f16" if SOC_MKE18F16
```

## soc/nxp/kinetis/kl2x/Kconfig.soc
```kconfig
# Kinetis KL2x MCU series

# Copyright 2024 NXP
# SPDX-License-Identifier: Apache-2.0

config SOC_SERIES_KINETIS_KL2X
	bool
	select SOC_FAMILY_KINETIS

config SOC_SERIES
	default "kl2x" if SOC_SERIES_KINETIS_KL2X

config SOC_MKL25Z4
	bool
	select SOC_SERIES_KINETIS_KL2X

config SOC
	default "mkl25z4" if SOC_MKL25Z4
```

## soc/nxp/kinetis/kv5x/Kconfig.soc
```kconfig
# Kinetis KV5x series MCU

# Copyright 2024 NXP
# SPDX-License-Identifier: Apache-2.0

config SOC_SERIES_KINETIS_KV5X
	bool
	select SOC_FAMILY_KINETIS

config SOC_SERIES
	default "kv5x" if SOC_SERIES_KINETIS_KV5X

config SOC_MKV56F24
	bool
	select SOC_SERIES_KINETIS_KV5X

config SOC_MKV58F24
	bool
	select SOC_SERIES_KINETIS_KV5X

config SOC
	default "mkv56f24" if SOC_MKV56F24
	default "mkv58f24" if SOC_MKV58F24
```

## soc/nxp/kinetis/kwx/Kconfig.soc
```kconfig
# Kinetis KWx MCU series

# Copyright 2024 NXP
# SPDX-License-Identifier: Apache-2.0

config SOC_SERIES_KINETIS_KWX
	bool
	select SOC_FAMILY_KINETIS

config SOC_SERIES
	default "kwx" if SOC_SERIES_KINETIS_KWX

config SOC_MKW22D5
	bool
	select SOC_SERIES_KINETIS_KWX

config SOC_MKW24D5
	bool
	select SOC_SERIES_KINETIS_KWX

config SOC_MKW40Z4
	bool
	select SOC_SERIES_KINETIS_KWX

config SOC_MKW41Z4
	bool
	select SOC_SERIES_KINETIS_KWX

config SOC
	default "mkw22d5" if SOC_MKW22D5
	default "mkw24d5" if SOC_MKW24D5
	default "mkw40z4" if SOC_MKW40Z4
	default "mkw41z4" if SOC_MKW41Z4
```

## tests/drivers/pwm/pwm_loopback/testcase.yaml
```yaml
tests:
  drivers.pwm.loopback:
    tags:
      - pwm
      - drivers
      - userspace
    depends_on: pwm
    filter: dt_compat_enabled("test-pwm-loopback")
     extra_configs:
      - CONFIG_PWM_MCUX_FLEXIO=y
    filter: CONFIG_MCUX_FLEXIO
    platform_allow: mr_canhubk3
    harness: ztest
    harness_config:
      fixture: pwm_loopback
```

## tests/subsys/sd/sdmmc/testcase.yaml
```yaml
tests:
  subsys.sd.sdmmc:
    harness: ztest
    harness_config:
      fixture: fixture_sdhc
    filter: CONFIG_SDHC
    tags: sdhc
    integration_platforms:
      - mimxrt1064_evk
```
