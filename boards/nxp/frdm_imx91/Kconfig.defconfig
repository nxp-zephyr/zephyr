## boards/nxp/frdm_imx91/Kconfig.defconfig
```kconfig
if BOARD_FRDM_IMX91

if IMX_USDHC

config GPIO
	default y

endif # IMX_USDHC

endif # BOARD_FRDM_IMX93
```

## boards/shields/nxp_rpi_cam_mipi_ap1302/Kconfig.defconfig
```kconfig
# Copyright 2025 NXP
# SPDX-License-Identifier: Apache-2.0

if SHIELD_NXP_RPI_CAM_MIPI_AP1302

if VIDEO

config GPIO
	default y

config REGULATOR
	default y

config MFD_ADP5585_INIT_PRIORITY
	default 55

config GPIO_ADP5585_INIT_PRIORITY
	default 56

config GPIO_PCA_SERIES_INIT_PRIORITY
	default 60

config REGULATOR_FIXED_INIT_PRIORITY
	default 75

config VIDEO_AP1302_INIT_PRIORITY
	default 80

endif # VIDEO

endif # SHIELD_NXP_RPI_CAM_MIPI_AP1302
```

## boards/shields/nxp_rpi_cam_mipi_ap1302/Kconfig.shield
```kconfig
# Copyright 2025 NXP
# SPDX-License-Identifier: Apache-2.0

config SHIELD_NXP_RPI_CAM_MIPI_AP1302
	def_bool $(shields_list_contains,nxp_rpi_cam_mipi_ap1302)
```

## drivers/video/Kconfig.ap1302
```kconfig
# AP1302

# Copyright 2025 NXP
# SPDX-License-Identifier: Apache-2.0

config VIDEO_AP1302
	bool "AP1302 advanced image coprocessor for onsemi's sensor"
	select I2C
	depends on REGULATOR
	depends on DT_HAS_ONNN_AP1302_ENABLED
	default y
	help
	  Enable driver for AP1302 which is an advanced image coprocessor for onsemi's sensor

if VIDEO_AP1302
config VIDEO_AP1302_INIT_PRIORITY
	int "AP1302 initialization priority"
	default 60
endif
```

## drivers/video/Kconfig.mcux_isi
```kconfig
# NXP ISI driver configuration options

# Copyright 2025 NXP
# SPDX-License-Identifier: Apache-2.0

config VIDEO_MCUX_ISI
	bool "NXP MCUX Image Sensing Interface (ISI) driver"
	default y
	depends on DT_HAS_NXP_IMX_ISI_ENABLED
	help
	  Enable driver for Image Sensing Interface (ISI).

config VIDEO_MCUX_ISI_INIT_PRIORITY
	int "ISI initialization priority"
	default 80
	depends on VIDEO_MCUX_ISI
```

## dts/bindings/video/nxp,dwc-mipi-csi2rx.yaml
```yaml
#
# Copyright 2025 NXP
#
# SPDX-License-Identifier: Apache-2.0
#

description: DWC MIPI CSI-2 Rx interface

compatible: "nxp,dwc-mipi-csi2rx"

include: [base.yaml]

properties:
  gasket:
    required: true
    type: phandle
    description: gasket

  data-lanes:
    required: true
    type: int
    description: Data lane numbers

  cfg-clk-range:
    required: true
    type: int
    description: MIPI D-PHY configure clock range

  hs-clk-range:
    required: true
    type: int
    description: MIPI D-PHY high-speed frequency range

  cam-pix-clk-rate:
    required: true
    type: int

  mipi-phy-cfg-clk-rate:
    required: true
    type: int

child-binding:
  child-binding:
    include: video-interfaces.yaml
    properties:
      reg:
        type: int
        enum:
          - 0 # for input endpoint
          - 1 # for output endpoint
```

## dts/bindings/video/nxp,imx-isi.yaml
```yaml
#
# Copyright 2025 NXP
#
# SPDX-License-Identifier: Apache-2.0
#

description: NXP MCUX Image Sensing Interface

compatible: "nxp,imx-isi"

include: [base.yaml, pinctrl-device.yaml]

properties:
  interrupts:
    required: true

  media-axi-clk-rate:
    required: true
    type: int

  media-apb-clk-rate:
    required: true
    type: int

child-binding:
  child-binding:
    include: video-interfaces.yaml
```

## dts/bindings/video/onnn,ap1302.yaml
```yaml
# Copyright 2025 NXP
# SPDX-License-Identifier: Apache-2.0

description: AP1302 ISP

compatible: "onnn,ap1302"

include: [i2c-device.yaml, pinctrl-device.yaml]

properties:
  regulators:
    required: true
    type: phandles

  isp_en-gpios:
    required: true
    type: phandle-array
    description: |
      This pin is asserted to enable AP1302. Driver will
      initialize this GPIO to active high.

  reset-gpios:
    required: true
    type: phandle-array
    description: |
      The RESETB pin is asserted to cause a hard reset. The AP1302
      receives this as an active-low signal.

  firmware:
    required: true
    type: phandles

child-binding:
  child-binding:
    include: video-interfaces.yaml
```

## samples/drivers/video/capture/Kconfig
```kconfig
# Copyright (c) 2024 Espressif Systems (Shanghai) Co., Ltd.
# SPDX-License-Identifier: Apache-2.0

mainmenu "Video capture sample application"

menu "Video capture configuration"

config VIDEO_FRAME_HEIGHT
	int "Height of the video frame"
	default 0
	help
	  Height of the video frame. If set to 0, the default height is used.

config VIDEO_FRAME_WIDTH
	int "Width of the video frame"
	default 0
	help
	  Width of the video frame. If set to 0, the default width is used.

config VIDEO_PIXEL_FORMAT
	string "Pixel format of the video frame"
	help
	  Pixel format of the video frame. If not set, the default pixel format is used.

config VIDEO_CTRL_HFLIP
	bool "Mirror the video frame horizontally"
	help
	  If set, mirror the video frame horizontally

config VIDEO_CAMERA_HEIGHT
	int "Height of the camera frame"
	default 0
	help
	  Height of the camera frame. If set to 0, the default height is used.

config VIDEO_CAMERA_WIDTH
	int "Height of the camera frame"
	default 0
	help
	  Width of the camera frame. If set to 0, the default width is used.

config VIDEO_CAMERA_PIXEL_FORMAT
	string "Pixel format of the camera frame"
	help
	  Pixel format of the camera frame. If not set, the default pixel format is used.
endmenu

source "Kconfig.zephyr"
```

## samples/drivers/video/capture/boards/frdm_imx93_mimx9352_a55.conf
```kconfig
CONFIG_LOG_MODE_MINIMAL=y

CONFIG_VIDEO_BUFFER_POOL_SZ_MAX=4096000
CONFIG_VIDEO_BUFFER_POOL_NUM_MAX=5

CONFIG_VIDEO_INIT_PRIORITY=85
CONFIG_VIDEO_MCUX_ISI_INIT_PRIORITY=90

CONFIG_VIDEO_FRAME_WIDTH=1024
CONFIG_VIDEO_FRAME_HEIGHT=600
CONFIG_VIDEO_PIXEL_FORMAT="AR24"

CONFIG_VIDEO_CAMERA_WIDTH=1024
CONFIG_VIDEO_CAMERA_HEIGHT=600
CONFIG_VIDEO_CAMERA_PIXEL_FORMAT="UYVY"

CONFIG_VIDEO_LOG_LEVEL_DBG=y
```
